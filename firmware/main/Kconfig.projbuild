## firmware/main/Kconfig.projbuild
```kconfig
# SPDX-License-Identifier: AGPL-3.0-or-later
menu "nuka diagnostics"
config NUKA_AUDIO_SPIKE
    bool "Run the FW2-05 hardware diagnostic once after boot"
    default n
    help
        Keep disabled in normal firmware. Start only with the operator ready.
config NUKA_AUDIO_SPIKE_STAGE
    int "Diagnostic stage (1=tone, 2=microphone, 3=PCM, 4=PCM/Opus comparison)"
    depends on NUKA_AUDIO_SPIKE
    range 1 4
    default 1
    help
        Stage 1 only plays one short, quiet synthesized tone. Stage 2 records
        channel statistics without storing audio. Stages 3 and 4 record five
        seconds in volatile PSRAM and play them back. Logs never contain audio.
endmenu
```

## firmware/sdkconfig.defaults
```kconfig
# SPDX-License-Identifier: AGPL-3.0-or-later
CONFIG_IDF_TARGET="esp32s3"
CONFIG_ESPTOOLPY_FLASHMODE_QIO=y
CONFIG_ESPTOOLPY_FLASHSIZE_16MB=y
CONFIG_PARTITION_TABLE_CUSTOM=y
CONFIG_PARTITION_TABLE_CUSTOM_FILENAME="partitions.csv"
CONFIG_SPIRAM=y
CONFIG_SPIRAM_MODE_OCT=y
CONFIG_SPIRAM_SPEED_80M=y
CONFIG_SPIRAM_USE_MALLOC=y
CONFIG_FREERTOS_TASK_CREATE_ALLOW_EXT_MEM=y
CONFIG_SPIRAM_TRY_ALLOCATE_WIFI_LWIP=y
CONFIG_COMPILER_OPTIMIZATION_PERF=y
CONFIG_ESP_DEFAULT_CPU_FREQ_MHZ_240=y
CONFIG_ESP32S3_DATA_CACHE_64KB=y
CONFIG_ESP32S3_DATA_CACHE_LINE_64B=y
CONFIG_ESP32S3_INSTRUCTION_CACHE_32KB=y
CONFIG_FREERTOS_HZ=1000
CONFIG_PM_ENABLE=y
CONFIG_FREERTOS_USE_TICKLESS_IDLE=y
CONFIG_ESP_TASK_WDT_EN=y
CONFIG_ESP_TASK_WDT_TIMEOUT_S=10
CONFIG_ESP_TASK_WDT_PANIC=y
CONFIG_FREERTOS_USE_TRACE_FACILITY=y
CONFIG_FREERTOS_GENERATE_RUN_TIME_STATS=y
CONFIG_BOOTLOADER_APP_ROLLBACK_ENABLE=y
# CONFIG_ESP_CONSOLE_USB_SERIAL_JTAG is not set
CONFIG_ESP_MAIN_TASK_STACK_SIZE=8192
CONFIG_LV_OS_FREERTOS=y
CONFIG_LV_USE_CUSTOM_MALLOC=y
# CONFIG_LV_ATTRIBUTE_FAST_MEM_USE_IRAM is not set
CONFIG_LV_COLOR_DEPTH_16=y
CONFIG_LV_DEF_REFR_PERIOD=16
CONFIG_LV_DRAW_SW_DRAW_UNIT_CNT=1
CONFIG_LV_FONT_FMT_TXT_LARGE=y
CONFIG_LV_USE_QRCODE=y
CONFIG_LV_FONT_MONTSERRAT_20=y
CONFIG_LV_FONT_MONTSERRAT_22=y
CONFIG_LV_FONT_MONTSERRAT_28=y
CONFIG_LV_FONT_MONTSERRAT_32=y
CONFIG_LV_FONT_MONTSERRAT_40=y
CONFIG_LV_FONT_MONTSERRAT_48=y
CONFIG_LV_FONT_DEFAULT_MONTSERRAT_28=y
CONFIG_MBEDTLS_CERTIFICATE_BUNDLE=y
CONFIG_MBEDTLS_INTERNAL_MEM_ALLOC=y
CONFIG_TINYUSB_CDC_ENABLED=y
CONFIG_TINYUSB_HID_COUNT=2
CONFIG_TINYUSB_DESC_USE_ESPRESSIF_VID=y
CONFIG_TINYUSB_DESC_MANUFACTURER_STRING="nuka"
CONFIG_TINYUSB_DESC_PRODUCT_STRING="nuka-esp32"


CONFIG_ESP_WIFI_IRAM_OPT=n
CONFIG_ESP_WIFI_RX_IRAM_OPT=n

CONFIG_ESP_CONSOLE_UART_DEFAULT=y

CONFIG_MBEDTLS_HKDF_C=y

CONFIG_TINYUSB_SUSPEND_CALLBACK=y

CONFIG_TINYUSB_RESUME_CALLBACK=y

CONFIG_TINYUSB_PM=y


CONFIG_LITTLEFS_MALLOC_STRATEGY_SPIRAM=y
CONFIG_NVS_ALLOCATE_CACHE_IN_SPIRAM=y
CONFIG_MDNS_MEMORY_ALLOC_SPIRAM=y
# CONFIG_MDNS_MEMORY_ALLOC_INTERNAL is not set
CONFIG_FREERTOS_PLACE_FUNCTIONS_INTO_FLASH=y
CONFIG_RINGBUF_PLACE_FUNCTIONS_INTO_FLASH=y
CONFIG_SPIRAM_ALLOW_BSS_SEG_EXTERNAL_MEMORY=y
CONFIG_SPIRAM_MALLOC_ALWAYSINTERNAL=0
# CONFIG_PM_POWER_DOWN_CPU_IN_LIGHT_SLEEP is not set
CONFIG_HEAP_PLACE_FUNCTION_INTO_FLASH=y
CONFIG_SPIRAM_MALLOC_RESERVE_INTERNAL=32768
CONFIG_ESP_WIFI_STATIC_RX_BUFFER_NUM=4
CONFIG_ESP_WIFI_STATIC_TX_BUFFER_NUM=2
CONFIG_ESP_WIFI_RX_BA_WIN=4
CONFIG_LV_DRAW_THREAD_STACK_SIZE=4096
CONFIG_MDNS_TASK_STACK_SIZE=2048
CONFIG_ESP_TIMER_TASK_STACK_SIZE=2048
CONFIG_ESP_SYSTEM_EVENT_TASK_STACK_SIZE=4096
```
